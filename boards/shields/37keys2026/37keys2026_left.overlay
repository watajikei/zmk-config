#include "37keys2026.dtsi"

&kscan0 {
    col-gpios
        = <&gpio0  4 (GPIO_ACTIVE_LOW | GPIO_PULL_UP)> // D4
        , <&gpio0  5 (GPIO_ACTIVE_LOW | GPIO_PULL_UP)> // D5
        , <&gpio1 15 (GPIO_ACTIVE_LOW | GPIO_PULL_UP)> // D10 (D6回避用の代替割り当て)
        , <&gpio1 12 (GPIO_ACTIVE_LOW | GPIO_PULL_UP)> // D7
        , <&gpio1 13 (GPIO_ACTIVE_LOW | GPIO_PULL_UP)> // D8
        , <&gpio1 14 (GPIO_ACTIVE_LOW | GPIO_PULL_UP)> // D9
        ;
};