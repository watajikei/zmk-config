#include <behaviors.dtsi>
#include <dt-bindings/zmk/keys.h>
#include <dt-bindings/zmk/outputs.h> // ★出力切り替え用の定義を読み込む

/ {
    keymap {
        compatible = "zmk,keymap";
        default_layer {
            // ボタンを押した瞬間に、出力を強制的にBluetooth（無線）に切り替える設定
            bindings = <&out OUT_BLE>; 
        };
    };
};